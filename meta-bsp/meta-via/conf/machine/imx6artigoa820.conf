## meta-bsp/meta-via/conf/machine/imx6artigoa820.conf
```bitbake
#@TYPE: Machine
#@NAME: VIA ARTiGO A820
#@SOC: i.MX6Q
#@DESCRIPTION: Machine configuration for VIA ARTiGO A820

require conf/machine/include/imx-base.inc
require conf/machine/include/tune-cortexa9.inc

MACHINEOVERRIDES =. "mx6:mx6q:mx6dl:"

KERNEL_DEVICETREE = "imx6q-artigoa820.dtb imx6dl-artigoa820.dtb imx6qp-artigoa820.dtb"

UBOOT_CONFIG ??= "sd"
UBOOT_CONFIG[sd] = "mx6artigoa820_config,sdcard"

SERIAL_CONSOLE = "115200 ttymxc0"

MACHINE_ESSENTIAL_EXTRA_RDEPENDS += "ax88772"

MACHINE_FIRMWARE += " linux-firmware-ath6k linux-firmware-ath9k linux-firmware-ar3k"

MACHINE_FEATURES += " pci wifi bluetooth"

IMAGE_CLASSES += "image_types_via"

SERIAL_CONSOLE = "115200 ttymxc1"

WIC_CREATE_EXTRA_ARGS_append = " --no-fstab-update"

PREFERRED_PROVIDER_u-boot_mx6 = "u-boot-imx"
PREFERRED_PROVIDER_virtual/bootloader_mx6 = "u-boot-imx"
PREFERRED_PROVIDER_virtual/kernel_mx6 = "linux-imx"
PREFERRED_VERSION_linux-imx = "4.9%"
```
